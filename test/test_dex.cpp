// Integrity of the Pokedex table (dex.h, generated by tools/gen_dex.py).

#pragma region Includes
#include "framework.h"
#include "shim/Arduino.h"
#include "../dex.h"
#include "../i18n.h"
#include "../pet.h"
#include <ctype.h>
#include <stdio.h>
#include <string.h>
#include <set>
#pragma endregion

#pragma region Table shape and names
static const int N = DEX_COUNT;

TEST(dex, every_table_has_dex_count_plus_one_entries) {
  CHECK_EQ((int)(sizeof(DEX_TBL) / sizeof(DEX_TBL[0])), N + 1);
  CHECK_EQ((int)(sizeof(DEX_NAME_FR) / sizeof(DEX_NAME_FR[0])), N + 1);
  CHECK_EQ((int)(sizeof(DEX_NAME_DE) / sizeof(DEX_NAME_DE[0])), N + 1);
  CHECK_EQ((int)(sizeof(DEX_NAME_JA) / sizeof(DEX_NAME_JA[0])), N + 1);
  CHECK_EQ((int)(sizeof(DEX_NAME_KO) / sizeof(DEX_NAME_KO[0])), N + 1);
}

TEST(dex, every_name_is_uppercase_ascii) {
  for (int d = 1; d <= N; d++) {
    const char *name = DEX_TBL[d].name;
    CHECK_MSG(name != NULL && name[0] != 0, "entry without a name");
    if (!name || !name[0]) continue;
    for (const char *character = name; *character; character++) {
      // the firmware's GFX font draws species names without lowercase
      CHECK_MSG((unsigned char)*character < 128, std::string("non-ASCII character in ") + name);
      CHECK_MSG(!islower((unsigned char)*character), std::string("lowercase letter in ") + name);
    }
  }
}

TEST(dex, translated_latin_names_are_uppercase_ascii_too) {
  const char *const *tables[2] = { DEX_NAME_FR, DEX_NAME_DE };
  for (int t = 0; t < 2; t++) {
    for (int d = 1; d <= N; d++) {
      const char *name = tables[t][d];
      if (!name) continue;  // no name of its own: falls back to DEX_TBL
      CHECK_MSG(name[0] != 0, "empty translated name");
      for (const char *character = name; *character; character++) {
        CHECK_MSG((unsigned char)*character < 128, std::string("non-ASCII character in ") + name);
        CHECK_MSG(!islower((unsigned char)*character), std::string("lowercase letter in ") + name);
      }
    }
  }
}

// the main screen header is char[32] with "%s%s" (shiny mark + name): no name
// in any language may overflow it (the name would be cut off on screen)
TEST(dex, no_name_overflows_the_header) {
  char head[32];
  for (int lang = 0; lang < LANG_COUNT; lang++) {
    gLang = (Lang)lang;
    for (int d = 1; d <= N; d++) {
      int need = snprintf(head, sizeof(head), "%s%s", "*", dexName(d));
      CHECK_MSG(need >= 0 && need < (int)sizeof(head),
                std::string("header cut off: ") + dexName(d));
    }
  }
  gLang = LANG_DEFAULT;
}
#pragma endregion

#pragma region Evolution chains
TEST(dex, evolutions_point_to_valid_entries) {
  for (int d = 1; d <= N; d++) {
    uint8_t evolvesTo = DEX_TBL[d].evolvesTo;
    CHECK_MSG(evolvesTo <= N, std::string("evolvesTo out of range in ") + DEX_TBL[d].name);
    CHECK_MSG(evolvesTo != d, std::string("evolves into itself: ") + DEX_TBL[d].name);
  }
}

TEST(dex, evolves_to_and_level_go_together) {
  for (int d = 1; d <= N; d++) {
    bool evolves = DEX_TBL[d].evolvesTo != 0;
    bool hasLevel = DEX_TBL[d].evolveLevel > 0;
    CHECK_MSG(evolves == hasLevel,
              std::string("evolvesTo and evolveLevel disagree in ") + DEX_TBL[d].name);
  }
}

TEST(dex, no_evolution_chain_loops) {
  for (int d = 1; d <= N; d++) {
    std::set<int> seen;
    int current = d;
    int guard = 0;
    while (current >= 1 && current <= N && DEX_TBL[current].evolvesTo != 0 && guard++ < N) {
      CHECK_MSG(seen.insert(current).second, std::string("evolution loop in ") + DEX_TBL[d].name);
      current = DEX_TBL[current].evolvesTo;
    }
    CHECK_MSG(guard < 6, std::string("chain too long from ") + DEX_TBL[d].name);
  }
}

TEST(dex, evolution_levels_rise_along_the_chain) {
  for (int d = 1; d <= N; d++) {
    int current = d, previousLevel = 0, guard = 0;
    while (DEX_TBL[current].evolvesTo != 0 && guard++ < 6) {
      CHECK_MSG(DEX_TBL[current].evolveLevel > previousLevel,
                std::string("evolution level does not rise in ") + DEX_TBL[current].name);
      previousLevel = DEX_TBL[current].evolveLevel;
      current = DEX_TBL[current].evolvesTo;
    }
  }
}

// a species obtainable only by evolution must be reachable from some egg,
// or it would be impossible to register in the pokedex
TEST(dex, every_species_is_reachable) {
  bool reachable[DEX_COUNT + 1] = { false };
  for (int d = 1; d <= N; d++) {
    if (DEX_TBL[d].rarity == R_EVO) continue;  // does not hatch from an egg
    int current = d, guard = 0;
    while (current >= 1 && current <= N && guard++ < 6) {
      reachable[current] = true;
      if (current == DEX_EEVEE) {  // special branch in the game code
        for (int branch = DEX_EEVEE_FIRST_BRANCH; branch <= DEX_EEVEE_LAST_BRANCH; branch++)
          reachable[branch] = true;
        break;
      }
      if (DEX_TBL[current].evolvesTo == 0) break;
      current = DEX_TBL[current].evolvesTo;
    }
  }
  for (int d = 1; d <= N; d++)
    CHECK_MSG(reachable[d], std::string("unreachable: ") + DEX_TBL[d].name);
}

// with the farewell at 3 days (level 72), every line must be able to reach its
// final form before the pet completes its cycle
TEST(dex, every_line_completes_before_the_farewell) {
  const uint32_t maxLevel = FAREWELL_AGE_MIN / MINUTES_PER_LEVEL;
  for (int d = 1; d <= N; d++) {
    if (DEX_TBL[d].rarity == R_EVO) continue;
    int current = d, guard = 0;
    uint32_t neededLevel = 0;
    while (DEX_TBL[current].evolvesTo != 0 && guard++ < 6) {
      if (DEX_TBL[current].evolveLevel > neededLevel) neededLevel = DEX_TBL[current].evolveLevel;
      current = DEX_TBL[current].evolvesTo;
    }
    CHECK_MSG(neededLevel <= maxLevel,
              std::string("the line of ") + DEX_TBL[d].name + " does not reach its final form in time");
  }
}
#pragma endregion

#pragma region Stats, biomes and rarities
TEST(dex, base_stats_are_plausible) {
  for (int d = 1; d <= N; d++) {
    const DexEntry &entry = DEX_TBL[d];
    CHECK_MSG(entry.bHp > 0 && entry.bAtk > 0 && entry.bDef > 0 && entry.bSpe > 0,
              std::string("base stat at zero in ") + entry.name);
    CHECK_MSG(entry.biome < BIOME_COUNT, std::string("unknown biome in ") + entry.name);
    CHECK_MSG(entry.rarity <= R_LEGENDARY, std::string("unknown rarity in ") + entry.name);
  }
}

TEST(dex, eevee_branch_matches_the_game_code) {
  CHECK_EQ((int)DEX_TBL[DEX_EEVEE].rarity, (int)R_COMMON);
  CHECK_RANGE((int)DEX_TBL[DEX_EEVEE].evolvesTo, DEX_EEVEE_FIRST_BRANCH, DEX_EEVEE_LAST_BRANCH);
  for (int d = DEX_EEVEE_FIRST_BRANCH; d <= DEX_EEVEE_LAST_BRANCH; d++) {
    CHECK_EQ((int)DEX_TBL[d].rarity, (int)R_EVO);
    CHECK_EQ((int)DEX_TBL[d].evolvesTo, 0);
  }
}

TEST(dex, classic_starters_are_valid) {
  CHECK_EQ((int)(sizeof(CLASSIC_DEX) / sizeof(CLASSIC_DEX[0])), NUM_CLASSIC_DEX);
  for (int i = 0; i < NUM_CLASSIC_DEX; i++) {
    int16_t d = CLASSIC_DEX[i];
    CHECK_RANGE(d, (int16_t)1, (int16_t)DEX_COUNT);
    CHECK_MSG(DEX_TBL[d].rarity != R_EVO, "a starter cannot be an evolved form");
  }
}

TEST(dex, every_rarity_has_at_least_one_species) {
  int countPerRarity[R_LEGENDARY + 1] = { 0 };
  for (int d = 1; d <= N; d++) countPerRarity[DEX_TBL[d].rarity]++;
  for (int rarity = 0; rarity <= R_LEGENDARY; rarity++)
    CHECK_MSG(countPerRarity[rarity] > 0,
              "a rarity has no species: the egg roll would run out of candidates");
}

// pickEggSpecies puts a tier's candidates in an 80-entry array: if any tier
// had more, the roll would only pick among the first 80
TEST(dex, no_tier_overflows_the_candidate_array) {
  for (int rarity = R_COMMON; rarity <= R_LEGENDARY; rarity++) {
    int candidateCount = 0;
    for (int d = 1; d <= N; d++)
      if (DEX_TBL[d].rarity == rarity) candidateCount++;
    CHECK_MSG(candidateCount <= 80, "more than 80 candidates in a tier: pickEggSpecies trims them");
  }
}
#pragma endregion

#pragma region Localized names
TEST(dex, dexName_falls_back_to_the_base_name_without_translation) {
  gLang = LANG_ES;
  CHECK_STREQ(dexName(1), DEX_TBL[1].name);
  gLang = LANG_FR;
  for (int d = 1; d <= N; d++) {
    const char *expectedName = DEX_NAME_FR[d] ? DEX_NAME_FR[d] : DEX_TBL[d].name;
    CHECK_STREQ(dexName(d), expectedName);
  }
  gLang = LANG_DE;
  for (int d = 1; d <= N; d++) {
    const char *expectedName = DEX_NAME_DE[d] ? DEX_NAME_DE[d] : DEX_TBL[d].name;
    CHECK_STREQ(dexName(d), expectedName);
  }
  gLang = LANG_DEFAULT;
}

TEST(dex, dexName_out_of_range_does_not_crash) {
  for (int lang = 0; lang < LANG_COUNT; lang++) {
    gLang = (Lang)lang;
    CHECK_STREQ(dexName(0), DEX_TBL[0].name);
    CHECK_STREQ(dexName(-1), DEX_TBL[0].name);
    CHECK_STREQ(dexName(DEX_COUNT + 1), DEX_TBL[0].name);
    CHECK_STREQ(dexName(30000), DEX_TBL[0].name);
  }
  gLang = LANG_DEFAULT;
}
#pragma endregion

#pragma region Battle types

TEST(dex, unused_entry_zero_has_no_battle_types) {
  CHECK_EQ((int)DEX_TBL[0].type1, (int)TYPE_NONE);
  CHECK_EQ((int)DEX_TBL[0].type2, (int)TYPE_NONE);
}

TEST(dex, every_species_has_a_valid_primary_battle_type) {
  for (int species = 1; species <= N; species++) {
    const DexEntry &entry = DEX_TBL[species];
    CHECK_MSG(entry.type1 != TYPE_NONE, std::string("no primary battle type: ") + entry.name);
    CHECK_MSG(entry.type1 < TYPE_COUNT, std::string("primary battle type out of range: ") + entry.name);
    CHECK_MSG(entry.type2 < TYPE_COUNT, std::string("secondary battle type out of range: ") + entry.name);
    CHECK_MSG(entry.type1 != entry.type2, std::string("same battle type twice: ") + entry.name);
  }
}

TEST(dex, battle_types_follow_the_modern_chart) {
  CHECK_EQ((int)DEX_TBL[1].type1, (int)TYPE_GRASS);     // Bulbasaur
  CHECK_EQ((int)DEX_TBL[1].type2, (int)TYPE_POISON);
  CHECK_EQ((int)DEX_TBL[6].type1, (int)TYPE_FIRE);      // Charizard
  CHECK_EQ((int)DEX_TBL[6].type2, (int)TYPE_FLYING);
  CHECK_EQ((int)DEX_TBL[35].type1, (int)TYPE_FAIRY);    // Clefairy (Normal before gen 6)
  CHECK_EQ((int)DEX_TBL[35].type2, (int)TYPE_NONE);
  CHECK_EQ((int)DEX_TBL[81].type1, (int)TYPE_ELECTRIC); // Magnemite (Steel since gen 2)
  CHECK_EQ((int)DEX_TBL[81].type2, (int)TYPE_STEEL);
  CHECK_EQ((int)DEX_TBL[94].type1, (int)TYPE_GHOST);    // Gengar
  CHECK_EQ((int)DEX_TBL[94].type2, (int)TYPE_POISON);
  CHECK_EQ((int)DEX_TBL[151].type1, (int)TYPE_PSYCHIC); // Mew
  CHECK_EQ((int)DEX_TBL[151].type2, (int)TYPE_NONE);
}

TEST(dex, caught_bitmap_has_one_bit_per_species) {
  CHECK_EQ((int)DEX_BITMAP_BYTES, (DEX_COUNT + 7) / 8);
  CHECK_MSG(DEX_BITMAP_BYTES * 8 >= DEX_COUNT, "the caught bitmap is too small for the dex");
}

#pragma endregion
